## config/boards/shields/jaan/Kconfig.shield
```kconfig
# Copyright (c) 2022 The ZMK Contributors
# SPDX-License-Identifier: MIT

config SHIELD_JAAN_LEFT
    def_bool $(shields_list_contains,jaan_left)

config SHIELD_JAAN_RIGHT
    def_bool $(shields_list_contains,jaan_right)
```

## config/west.yml
```yaml
manifest:
  remotes:
    - name: spamwax-zmk
      url-base: https://github.com/spamwax
    - name: dhruvinsh
      url-base: https://github.com/dhruvinsh
    - name: urob
      url-base: https://github.com/urob
    - name: caksoylar
      url-base: https://github.com/caksoylar
    - name: m165437 #new entry
      url-base: https://github.com/M165437
  projects:
    - name: zmk
      remote: spamwax-zmk
      revision: mainline
      clone-depth: 1
      import: app/west.yml
    - name: zmk-tri-state
      remote: caksoylar
      revision: main
    - name: zmk-num-word
      remote: dhruvinsh
      revision: main
    - name: zmk-auto-layer
      remote: urob
      revision: v0.1 # set to same version as zmk
    - name: nice-view-gem
      remote: m165437
      revision: main
  self:
    path: config
```
